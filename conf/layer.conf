## conf/layer.conf
```bitbake
# We have a conf and classes directory, append to BBPATH
BBPATH .= ":${LAYERDIR}"

# We have a recipes directory, add to BBFILES
BBFILES += "${LAYERDIR}/recipes*/*/*.bb ${LAYERDIR}/recipes*/*/*.bbappend ${LAYERDIR}/recipes*/*/*/*.bb ${LAYERDIR}/recipes*/*/*/*.bbappend"

# We have a packagegroups directory, add to BBFILES
BBFILES += "${LAYERDIR}/packagegroups/*.bb ${LAYERDIR}/packagegroups/*.bbappend"

# We have an images directory, add to BBFILES
BBFILES += "${LAYERDIR}/images/*.bb ${LAYERDIR}/images/*.bbappend ${LAYERDIR}/images/*/*.bbappend ${LAYERDIR}/images/*/*.bb"

BBFILE_COLLECTIONS += "meta-workshop"
BBFILE_PATTERN_meta-workshop := "^${LAYERDIR}/"
# meta-arago-distro and meta-arag-extras use priority 10 so make sure we override them
BBFILE_PRIORITY_meta-workshop = "11"
```
